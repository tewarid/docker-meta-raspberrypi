## layers/meta-amora/conf/layer.conf
```bitbake
# We have a conf and classes directory, append to BBPATH
BBPATH .= ":${LAYERDIR}"

# We have a recipes directory, add to BBFILES
BBFILES += "${LAYERDIR}/recipes-*/*/*.bb ${LAYERDIR}/recipes-*/*/*.bbappend"

BBFILE_COLLECTIONS += "amora-layer"
BBFILE_PATTERN_amora-layer := "^${LAYERDIR}/"
BBFILE_PRIORITY_amora-layer = "7"

LAYERVERSION_amora-layer = "1"
LAYERSERIES_COMPAT_amora-layer = "dunfell gatesgarth hardknott"

LAYERDEPENDS_amora-layer = "core"
```
